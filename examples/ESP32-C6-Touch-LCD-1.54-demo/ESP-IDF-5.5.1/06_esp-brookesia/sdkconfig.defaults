## examples/ESP32-C6-Touch-LCD-1.54-demo/ESP-IDF-5.5.1/06_esp-brookesia/sdkconfig.defaults
```kconfig
CONFIG_IDF_TARGET="esp32c6"
CONFIG_ESPTOOLPY_FLASHMODE_QIO=y
CONFIG_ESPTOOLPY_FLASHSIZE_16MB=y
CONFIG_PARTITION_TABLE_CUSTOM=y
CONFIG_COMPILER_OPTIMIZATION_PERF=y
CONFIG_ESP_CONSOLE_USB_SERIAL_JTAG=y
CONFIG_FATFS_LFN_HEAP=y
CONFIG_FATFS_API_ENCODING_UTF_8=y
CONFIG_FREERTOS_HZ=1000
CONFIG_ESP_BROOKESIA_ENABLE_AI_FRAMEWORK=n
CONFIG_ESP_BROOKESIA_GUI_ENABLE_ANIM_PLAYER=n
CONFIG_ESP_BROOKESIA_ENABLE_SERVICES=n
CONFIG_ESP_BROOKESIA_SYSTEMS_ENABLE_SPEAKER=n
CONFIG_BOOST_MATH_ENABLED=n
CONFIG_BOOST_SERIALIZATION_ENABLED=n
CONFIG_LV_USE_CLIB_MALLOC=y
CONFIG_LV_USE_CLIB_STRING=y
CONFIG_LV_USE_CLIB_SPRINTF=y
CONFIG_LV_OS_FREERTOS=y
CONFIG_LV_DEF_REFR_PERIOD=15
CONFIG_LV_OBJ_STYLE_CACHE=y
CONFIG_LV_DRAW_SW_DRAW_UNIT_CNT=2
CONFIG_COMPILER_OPTIMIZATION_PERF=y
CONFIG_ESP_LVGL_ADAPTER_ENABLE_FPS_STATS=y
CONFIG_LV_USE_FS_STDIO=y
CONFIG_LV_FS_STDIO_LETTER=65
CONFIG_LV_FS_STDIO_PATH=""
CONFIG_LV_USE_TJPGD=n
```
